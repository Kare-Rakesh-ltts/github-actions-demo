AUTOSAR XML (schema 4.0)
package /ECUConfig
  ecu configuration ECUConfig_V2
    ecu instance ECU1: hw=HWPlatform_B
    software component EngineControl: version=2.0.0
    software component TransmissionControl: version=1.0.0
