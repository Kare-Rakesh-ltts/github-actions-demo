AUTOSAR XML (schema 4.0)
package /ECUConfig
  ecu configuration ECUConfig_V1
    ecu instance ECU1: hw=HWPlatform_A
    software component EngineControl: version=1.0.0
